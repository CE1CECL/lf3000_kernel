## arch/arm/mach-nxp4330/Kconfig
```kconfig
#
# Copyright 2009 Nexell.
#

config ARCH_CPU_NEXELL
	bool
	default y

choice
	prompt "Prototype build mode"
	default PROTOTYPE_RELEASE

config  PROTOTYPE_RELEASE
	bool "Release"

config  PROTOTYPE_DEBUG
	bool "Debug"
endchoice

choice
	prompt "Memory max order"
	default MEM_MAX_ORDER_11

config	MEM_MAX_ORDER_11
	bool "4Mbyte"

config	MEM_MAX_ORDER_12
    bool "8Mbyte"

config	MEM_MAX_ORDER_13
	bool "16Mbyte"

endchoice

config FORCE_MAX_ZONEORDER
   	int
   	default 11 if MEM_MAX_ORDER_11
   	default 12 if MEM_MAX_ORDER_12
   	default 13 if MEM_MAX_ORDER_13

comment "CPU features"

config SUSPEND_IDLE
	bool "Goto idle when Supend"
	depends on SUSPEND
	default n

config PM_DBGOUT
	bool "Verbose Power debugging"
	default n

config HAVE_PWM
	prompt "PWM driver"
	bool
	select NEXELL_SOC_PWM
	default y

config PWM_SYSFS
	bool "/sys/devices/platform/pwm.N (sysfs interface)"
	depends on HAVE_PWM
	default y

config HAVE_PWM_CH0
	bool "pwm 0"
	depends on HAVE_PWM
	default y

config HAVE_PWM_CH1
	bool "pwm 1"
	depends on HAVE_PWM
	default n

config HAVE_PWM_CH2
	bool "pwm 2"
	depends on HAVE_PWM
	default n

config HAVE_PWM_CH3
	bool "pwm 3"
	depends on HAVE_PWM
	default n

config NEXELL_SOC_PWM
	bool "Support PWM soc"
	default y if HAVE_PWM

config NEXELL_SOC_DISP
	bool "Support Display soc"
	default n

config NEXELL_SOC_DISP_PRI
	bool "Primary   display output"
	depends on NEXELL_SOC_DISP

config NEXELL_SOC_DISP_SEC
	bool "Secondary display output"
	depends on NEXELL_SOC_DISP

config NEXELL_SOC_DISP_LCDIF
	bool "LCD Interface"
	depends on NEXELL_SOC_DISP

config NEXELL_SOC_DISP_LVDS
	bool "LVDS"
	depends on NEXELL_SOC_DISP

config NEXELL_SOC_DISP_HDMI
	bool "HDMI"
	depends on NEXELL_SOC_DISP

config NEXELL_SOC_DISP_MIPI
	bool "MiPi"
	depends on NEXELL_SOC_DISP

config NEXELL_SOC_DISP_RESCONV
	bool "Resolution Converter"
	depends on NEXELL_SOC_DISP

config ADC_NEXELL
	tristate "Nexell ADC"
	depends on ARCH_NXP4330
	default y
	---help---
	This option enables the Nexell ADC driver.  

config SOC_LFP100
	tristate "Support for the LFP100/LFP200/LFP300/LFP400 audio/power/backlight chip"
	depends on (PLAT_NXP4330_R3K || PLAT_NXP4330_CABO || PLAT_NXP4330_GLASGOW_ALPHA || PLAT_NXP4330_XANADU || PLAT_NXP4330_LOWCOST)
	default y
	---help---
	This option enables platform support for the LFP100 combination
	chip.  It is checked at runtime.  If you are unsure, say Y.
	This option is only for all LeapFrog boards. 

config BQ24250_CHARGER
	bool "BQ24250 Charger"
	depends on (PLAT_NXP4330_CABO || PLAT_NXP4330_XANADU)
	default y
	---help---
	This option enables BQ24250 charger chip driver. This driver is only required for Cabo.

config TC7734_PMIC
	bool "TC7734 PMIC"
	depends on PLAT_NXP4330_XANADU
	default n
	---help---
	This option enables the TC7734 PMIC driver.

choice
        prompt "System Power Down Mode"
        default POWER_DOWN_STANDBY
	---help---
	This option chooses whether the system completely powers off or goes into standby mode.

config  POWER_DOWN_OFF
        bool "Off"
	---help---
	Place system in OFF mode

config  POWER_DOWN_STANDBY
        bool "Standby"
	---help---
	Place system in STANDBY mode

config  POWER_DOWN_SRC_DEP
        bool "Off"
	---help---
	Place system in either OFF or STANDBY mode, based on the power source

endchoice

source "kernel/Kconfig.hz"
source "arch/arm/plat-nxp4330/Kconfig"
# source "arch/arm/mach-nxp4330/gpio/Kconfig"
```

## arch/arm/plat-nxp4330/Kconfig
```kconfig
#
# Copyright 2009 Nexell.
#
# Configuration options for the NXP4330

config PLAT_NXP4330
	bool
	default y

#===============================================================================
# Select Board
#===============================================================================
	comment "Board features"

choice
    prompt "Platform board"
    default PLAT_NXP4330_LYNX

	config PLAT_NXP4330_LYNX
		bool "LYNX: Android MID board"
		help
   	 		Support for the android MID (Lynx) board.

	config PLAT_NXP4330_VTK
		bool "VTK: Validation Kit board"
		help
   	 		Support for the validation kit board.

	config PLAT_NXP4330_SMARTBOX
		bool "SMARTBOX: Android Smart Box"
		help
   	 		Support for the android smart box board.
   	 		
   	config PLAT_NXP4330_R3K
		bool "LeapFrog R3K board"
		help
   	 		Placeholder for all LeapFrog boards.

	config PLAT_NXP4330_CABO
                bool "LeapFrog CABO board"
                help
                        Placeholder for all LeapFrog CABO boards.

   	config PLAT_NXP4330_GLASGOW_ALPHA
		bool "LeapFrog Glasgow board (ALPHA)"
		help
   	 		Platform Support for LeapFrog Glasgow board (ALPHA).

	config PLAT_NXP4330_XANADU
		bool "LeapFrog XANADU board"
		help
			Platform Support for LeapFrog Xanadu Boards.
					
endchoice

config NXP4330_LEAPFROG
	bool "Any LeapFrog board with LF3000"
	depends on PLAT_NXP4330_CABO || PLAT_NXP4330_GLASGOW_ALPHA || PLAT_NXP4330_R3K || PLAT_NXP4330_XANADU
	default y
	---help---
	This option ought to be selected for all LeapFrog boards (and
	only LeapFrog boards).  Selecting it disables Nexell code that 
	zeroes the ALIVE scratch register. 


choice
    prompt "Platform board LCD size"
    default NEXELL_SOC_DISP_LCD_1024x600

config NEXELL_SOC_DISP_LCD_480x272
	bool "480x272 LCD"
	depends on NEXELL_SOC_DISP_LCDIF

config NEXELL_SOC_DISP_LCD_1024x600
	bool "1024x600 LCD"
	depends on NEXELL_SOC_DISP_LCDIF

config NEXELL_SOC_DISP_LCD_1280x800
	bool "1280x800 LCD"
	depends on NEXELL_SOC_DISP_LCDIF

endchoice

#===============================================================================
# Board dependent configure
#===============================================================================
if PLAT_NX4330_LYNX
source "arch/arm/plat-nxp4330/lynx/Kconfig"
endif

if PLAT_NXP4330_VTK
source "arch/arm/plat-nxp4330/vtk/Kconfig"
endif

if PLAT_NXP4330_R3K
source "arch/arm/plat-nxp4330/r3k/Kconfig"
endif
```
